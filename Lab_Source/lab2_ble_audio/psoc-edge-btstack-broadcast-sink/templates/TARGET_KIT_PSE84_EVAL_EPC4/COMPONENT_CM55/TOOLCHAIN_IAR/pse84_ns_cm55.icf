/***************************************************************************//**
* \file pse84_ns_cm55.icf
* \version 1.0.0
*
* Linker file for the IAR compiler.
*
* The main purpose of this file is to describe how the sections in the
* input files should be mapped into the output file, and to control the memory
* layout of the output file.
*
*
* \note The linker files included with the PDL template projects must be generic
* and handle all common use cases. Your project may not use every section
* defined in the linker files. In that case you may see warnings during the
* build process. In your project, you can simply comment out or remove the
* relevant code in the linker file.
*
********************************************************************************
* \copyright
* Copyright (c) (2020-2025), Cypress Semiconductor Corporation (an Infineon company) or
* an affiliate of Cypress Semiconductor Corporation.
* SPDX-License-Identifier: Apache-2.0
*
* Licensed under the Apache License, Version 2.0 (the "License");
* you may not use this file except in compliance with the License.
* You may obtain a copy of the License at
*
*     http://www.apache.org/licenses/LICENSE-2.0
*
* Unless required by applicable law or agreed to in writing, software
* distributed under the License is distributed on an "AS IS" BASIS,
* WITHOUT WARRANTIES OR CONDITIONS OF ANY KIND, either express or implied.
* See the License for the specific language governing permissions and
* limitations under the License.
*******************************************************************************/

/* Include the device memory definitions generated by the Device Configurator */
include  "../../config/GeneratedSource/cymem_ilinkarm_CM55_0.icf";

/* Define the stack size for the application
  To set stack size in application add makefile ldflags: --config_def APP_MSP_STACK_SIZE=<CUSTOM_VALUE> */
if (!isdefinedsymbol(APP_MSP_STACK_SIZE))
{
  /* default stack size */
  define symbol APP_MSP_STACK_SIZE = 0x00001000;
}
define symbol __ICFEDIT_size_cstack__ = APP_MSP_STACK_SIZE;

/* Defines the minimum heap size. The actual heap size will be expanded to the end of the stack region */
if (!isdefinedsymbol(HEAP_SIZE))
{
  /* default heap size */
  define symbol HEAP_SIZE = 0x00001000;
}
define symbol __ICFEDIT_size_heap__ = HEAP_SIZE;

/* Device definitions */
define symbol VECTORS_ALIGNMENT = 0x400;
define symbol __ICFEDIT_intvec_start__ = CYMEM_CM55_0_m55_nvm_sel_START;

define memory mem with size = 4G;

/* The size of the MCU boot header area at the start of main code region */
define symbol MCUBOOT_HEADER_SIZE = 0x400;

/* Include the memory regions generated by the Device Configurator.
  This file contains the memory region definitions for the device,
  which are used to define the memory layout in this linker script. */

include  "../../config/GeneratedSource/cymem_ilinkarm_regions_CM55_0.icf";

/* Block definitions */

/* Define a block for performance-sensitive or critical functions that need to be executed in SRAM */
define block RAM_APP with alignment = 4
{
  section .cy_itcm,
  section .cy_ramfunc,
  readwrite section *.cy_os_common,
  
  /* DRIVER_RELATED */
  readwrite code object cy_syslib_ext.*,
  readwrite code object cy_syslib.*,
  readwrite code object cy_smif.*,
  readwrite code object cy_smif_memslot.*,
  readwrite code object cy_smif_memnum.*,
  readwrite code object cy_smif_sfdp.*,
  readwrite code object cy_smif_hb_flash.*,
  readwrite code object mtb_hal_memoryspi.*,
  readwrite code object mtb_serial_memory.*,
  readwrite code object *cmsis*.*,
  
  /* RTOS */
  readwrite code object *queue.*,
  readwrite code object *tasks.*,
  readwrite code object *timers.*,
  readwrite code object *heap_3.*,
  readwrite code object *list.*,
  readwrite code object *event_groups.*,
  readwrite code object *port.*,
  readwrite code object *portasm.*,
  readwrite code object *portdsram.*,
  readwrite code object *freertos/Source/*.*,
  readwrite code object *clib-support/*.*,
  readwrite code object *cy_clib_support*.*,
  readwrite code object *abstraction-rtos/*.*,
  readwrite code object *cy_mutex_pool*.*,
  readwrite code object *cy_time*.*,
  readwrite code object *cyabs*.*,
  readwrite code object *cy_worker_thread.*,
  
  /* AUDIO_SW_CODEC */
  readwrite code object *asc_lc3.a:*,
  
  /* BLUETOOTH_AUDIO_PATH */
  readwrite code object *cy_scb_common.*,
  readwrite code object *cy_scb_uart.*,
  readwrite code object *mtb_hal_uart.*,
  readwrite code object *platform_hal_wrapper.*,
  readwrite code object *cybt_host_stack_platform_interface.*,
  readwrite code object *cybt_hci_rx_task.*,
  readwrite code object *cybt_platform_task.*,
  readwrite code object *cybt_platform_freertos.*,
  readwrite code object *libbtstack.a:*,
  readwrite code object *unicast_sink_isoc.*,
  readwrite code object *audio_decoder_task.*,
  readwrite code object *audio_driver_i2s_task.*
};

/* Define blocks for SRAM0 and SRAM1 code */
define block SRAM0_APP with alignment = 4
{
  section .cy_sram0_code,
  section .cy_sram_code,
  /* BLUETOOTH_CONTROLLER_FW - readwrite sections only */
  readwrite object *btfw.*
};

define block SRAM1_APP with alignment = 4
{
  section .cy_sram1_code
};

/* Define the stack and heap blocks */
define block CSTACK with alignment = 8, size = __ICFEDIT_size_cstack__ { };
define block HEAP with expanding size, alignment = 8, minimum size = __ICFEDIT_size_heap__ { };

/* Define the RAM data and bss blocks */
define block RAM_DATA { readwrite section .data };
define block RAM_BSS { readwrite section .bss };
define block RAM_NOINIT { readwrite section .noinit };
define block RAM_OTHER { 
  readwrite
};
/* Remove the unused RAM block definition - using individual blocks instead */

/* Define SRAM1 data blocks */
define block SRAM1_DATA { 
  section .cy_sram1_data,
  section .cy_socmem_data
};

/* Define the RAM vector block */
define block RAM_VECTOR with alignment = VECTORS_ALIGNMENT { section .intvec_ram };

/* Initialization */
do not initialize { section .noinit, section .intvec_ram, section .cy_sharedmem };
initialize by copy
{
  readwrite,
  section .cy_itcm,
  section .cy_sram0_code,
  section .cy_sram1_code,
  section .cy_sram_code,
  section .cy_ramfunc,
  section .cy_sram1_data,
  section .cy_socmem_data,
  section .cy_socmem_code,
  readonly section *.cy_os_common,
  readonly object *crtbegin.*,
  readonly object *crt0.*,
  readonly object *ns_start_pse84.*,
  readonly object *ns_system_pse84.*,
  readonly object *cy_device.*,
  readonly object *cy_sysclk.*,
  readonly object *cy_sysclk_v2.*,
  readonly object *libgcc.a:,
  readonly object *libg_nano.a:,
  readonly object *cy_syspm_ppu.*,
  readonly object *cy_syspm_v4.*,
  readonly object *ppu_v1.*,
  readonly object cy_syslib_ext.*,
  readonly object cy_syslib.*,
  readonly object cy_smif.*,
  readonly object cy_smif_memslot.*,
  readonly object cy_smif_memnum.*,
  readonly object cy_smif_sfdp.*,
  readonly object cy_smif_hb_flash.*,
  readonly object mtb_hal_memoryspi.*,
  readonly object mtb_serial_memory.*,
  readonly object *cmsis*.*,
  readonly object *queue.*,
  readonly object *tasks.*,
  readonly object *timers.*,
  readonly object *heap_3.*,
  readonly object *list.*,
  readonly object *event_groups.*,
  readonly object *port.*,
  readonly object *portasm.*,
  readonly object *portdsram.*,
  readonly object *freertos/Source/*.*,
  readonly object *clib-support/*.*,
  readonly object *cy_clib_support*.*,
  readonly object *abstraction-rtos/*.*,
  readonly object *cy_mutex_pool*.*,
  readonly object *cy_time*.*,
  readonly object *cyabs*.*,
  readonly object *cy_worker_thread.*,
  readonly object *asc_lc3.a:*,
  readonly object *cy_scb_common.*,
  readonly object *cy_scb_uart.*,
  readonly object *mtb_hal_uart.*,
  readonly object *platform_hal_wrapper.*,
  readonly object *cybt_host_stack_platform_interface.*,
  readonly object *cybt_hci_rx_task.*,
  readonly object *cybt_platform_task.*,
  readonly object *cybt_platform_freertos.*,
  readonly object *libbtstack.a:*,
  readonly object *unicast_sink_isoc.*,
  readonly object *audio_decoder_task.*,
  readonly object *audio_driver_i2s_task.*,
  readonly object *btfw.*
};

/* Placement */
/* Serial Memory Interface block #0 memory #1, 16 MB */
/* A reserved region for MCUBoot header */
reserve region "MCUBOOT_HEADER" = [from start(m55_nvm_sel) size MCUBOOT_HEADER_SIZE];
/* Reserve a trail space for the signature for the bootloader - do not place any code here */
reserve region "M55_TRAILER" = [from (start(m55_trailer_sel)) size CYMEM_CM55_0_m55_trailer_SIZE];
/* Bootup essentials in flash */
place in m55_nvm_sel { first section .intvec, 
  readonly object *crtbegin.*,
  readonly object *crt0.*,
  readonly object *ns_start_pse84.*,
  readonly object *ns_system_pse84.*,
  readonly object *cy_device.*,
  readonly object *cy_sysclk.*,
  readonly object *cy_sysclk_v2.*,
  readonly object *libgcc.a:*,
  readonly object *libg_nano.a:*,
  readonly object *cy_syspm_ppu.*,
  readonly object *cy_syspm_v4.*,
  readonly object *ppu_v1.*,
  readonly object *btfw.*,
  readonly
};

/* SRAM0 - for bluetooth controller firmware (process first to claim btfw objects) */
place in cm55_code_sram0 { block SRAM0_APP };

/* SRAM1 - for additional code */
place in cm55_code_sram1 { block SRAM1_APP };

/* ITCM, 256 KB */
/* A piece intended for code placement */
/* Reserving the first 16 bytes to avoid debug symbols (that have default address 0x0) to be confused with actual code */
reserve region "ZERO_ADDRESS_MEM" = [from start(m55_code_INTERNAL) size 16];
place in m55_code_INTERNAL { section .ram_vectors, block RAM_APP };

/* System SRAM (SoCMEM), 5 MB */
/* A piece intended for less performance-sensitive or critical functions that might be executed in SOC memory */
place in m55_code_secondary { section .cy_socmem_code };

/* A piece intended for shared RAM memory where only the Cortex-M55 can allocate data but all cores can access */
place in m55_allocatable_shared { section .cy_sharedmem };

/* DTCM, 256 KB */
/* A piece intended for data placement */
place at start of m55_data_INTERNAL { block RAM_VECTOR };
place in          m55_data_INTERNAL { block RAM_DATA, block RAM_BSS, block RAM_NOINIT, block RAM_OTHER, section .cy_dtcm, block HEAP };
place at end   of m55_data_INTERNAL { block CSTACK };

/* System SRAM (SoCMEM), 5 MB */
/* A piece intended for data placement - kept empty */
place in        m55_data_secondary { };

/* SRAM1 data */
place in        cm55_data_sram1 { block SRAM1_DATA };

/* A piece intended for GPU buffer */
place in gfx_mem { section .cy_gpu_buf };

keep { section .intvec };
